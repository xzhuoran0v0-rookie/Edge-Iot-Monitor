#include "oled.h"

// OLED 走 ESP32-S3 的第二条硬件 I2C 总线 (Wire1)，与 SHT30 的默认 Wire (GPIO17/18) 隔离。
// 引脚为 OLED_SDA(38) / OLED_SCL(39)，在 OLED::init() 中 begin。
static TwoWire OLED_I2C = TwoWire(1);

uint8_t OLED::cursor_page_ = 0;
uint8_t OLED::cursor_col_ = 0;

// ASCII 5x7 字模（空格到Z，够用）
const uint8_t OLED::font5x7[][5] = {
    {0x00,0x00,0x00,0x00,0x00}, // ' '
    {0x00,0x00,0x5F,0x00,0x00}, // '!'
    {0x00,0x07,0x00,0x07,0x00}, // '"'
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    {0x00,0x06,0x09,0x06,0x00}, // '[' -> 度数符号 (°)，小圆圈显示在字符顶部
};

void OLED::sendCmd(uint8_t cmd)
{
    OLED_I2C.beginTransmission(OLED_ADDR);
    OLED_I2C.write(0x00);  // Co=0, D/C#=0 命令模式
    OLED_I2C.write(cmd);
    OLED_I2C.endTransmission();
}

void OLED::sendData(uint8_t *buf, size_t len)
{
    OLED_I2C.beginTransmission(OLED_ADDR);
    OLED_I2C.write(0x40);  // Co=0, D/C#=1 数据模式
    for (size_t i = 0; i < len; i++)
        OLED_I2C.write(buf[i]);
    OLED_I2C.endTransmission();
}

bool OLED::init()
{
    // 启动 OLED 专用 I2C 总线（Wire1: SDA=38, SCL=39）
    OLED_I2C.begin(OLED_SDA, OLED_SCL);

    // SSD1315 初始化序列
    const uint8_t cmds[] = {
        0xAE,        // 关显示
        0xD5, 0x80,  // 时钟分频
        0xA8, 0x3F,  // 多路复用比 64
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        0xAF,        // 开显示
    };

    for (uint8_t cmd : cmds)
        sendCmd(cmd);

    clear();
    Serial.println("[OLED] Init OK");
    return true;
}

void OLED::clear()
{
    for (uint8_t page = 0; page < 8; page++)
    {
        sendCmd(0xB0 + page);  // 设置页
        sendCmd(0x00);         // 列低位
        sendCmd(0x10);         // 列高位

        uint8_t blank[128] = {0};
        sendData(blank, 128);
    }
    cursor_page_ = 0;
    cursor_col_ = 0;
}

void OLED::setCursor(uint8_t page, uint8_t col)
{
    cursor_page_ = page;
    cursor_col_ = col;
    sendCmd(0xB0 + page);
    sendCmd(col & 0x0F);
    sendCmd(0x10 | (col >> 4));
}

void OLED::drawChar(char c)
{
    if (c < ' ' || c > '[')   // 字库范围：空格(0x20)~'['(0x5B)，'[' 复用为度数符号
        c = ' ';

    const uint8_t *glyph = font5x7[c - ' '];
    uint8_t buf[6];
    for (int i = 0; i < 5; i++)
        buf[i] = glyph[i];
    buf[5] = 0x00;  // 字符间距

    sendData(buf, 6);
    cursor_col_ += 6;
}

void OLED::drawString(const String &s)
{
    for (char c : s)
    {
        if (cursor_col_ >= OLED_WIDTH)
            break;
        drawChar(toupper(c));
    }
}

void OLED::showSensorData(float temp, float humi)
{
    clear();

    // 第一行：标题
    setCursor(0, 0);
    drawString("EDGE IOT MONITOR");

    // 第二行：温度
    setCursor(2, 0);
    drawString("TEMP: " + String(temp, 1) + "[C");  // '[' 在字库里是度数符号

    // 第三行：湿度
    setCursor(4, 0);
    drawString("HUMI: " + String(humi, 1) + "%");
}

void OLED::showAIResult(const String &result)
{
    clear();

    setCursor(0, 0);
    drawString("AI RESULT:");

    // 截断显示前两行
    setCursor(2, 0);
    drawString(result.substring(0, 21));

    setCursor(4, 0);
    drawString(result.substring(21, 42));
}

void OLED::showStatus(const String &msg)
{
    clear();
    setCursor(2, 0);
    drawString(msg);
}
